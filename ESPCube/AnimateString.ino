byte font[][64] = {
  {0,0,0,0,0,0,0,0,0,0,0,0,0,0,0,0,0,0,0,0,0,0,0,0,0,0,0,0,0,0,0,0,0,0,0,0,0,0,0,0,0,0,0,0,0,0,0,0,0,0,0,0,0,0,0,0,0,0,0,0,0,0,0,0},  //
  {0,0,0,1,1,0,0,0,0,0,0,1,1,0,0,0,0,0,0,1,1,0,0,0,0,0,0,1,1,0,0,0,0,0,0,1,1,0,0,0,0,0,0,1,1,0,0,0,0,0,0,0,0,0,0,0,0,0,0,1,1,0,0,0},  // ！
  {0,0,0,0,0,0,0,0,0,0,1,0,0,1,0,0,0,0,1,0,0,1,0,0,0,0,0,0,0,0,0,0,0,0,0,0,0,0,0,0,0,0,0,0,0,0,0,0,0,0,0,0,0,0,0,0,0,0,0,0,0,0,0,0},  // "
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  {0,0,0,0,0,0,0,0,0,0,0,0,0,0,0,0,0,0,0,0,0,0,0,0,0,0,1,1,1,1,0,0,0,0,0,1,0,0,0,0,0,0,0,0,1,0,0,0,0,0,1,1,1,1,0,0,0,0,0,0,0,0,0,0}   // z
  };

void copydatablock(byte (&font)[64], byte (&data)[8][32], int p) {
  for (int i = 0; i < 8; i++) {
    for (int j=p*8; j<p*8+8; j++)
      data[i][j] = font[i*8+j-p*8];
  }
}

void copyFrame(byte (&fr)[8][8], byte d[8][22], int p,byte val){
  for (int i = 0; i < 8; i++) {
    for (int j=0; j<8; j++)
      fr[i][j] += d[i][j+p]*val;
  }
}

void animateString(String text, int delaytime){
  int len = text.length();
  currentAnimationMaxSteps = (len+3)*8;
  animateStringEx(text, currentAnimationStep);
  delay(delaytime);
}

void animateStringEx(String text, int currentPos) {
  int len = text.length();

  // Generate orignal frame, 4 letters
  byte d0[8][32] = {0x00};
  int fontPos = currentPos/8;
  if (currentPos > fontPos*8) {
    fontPos ++;
  }
  
  for (int i=fontPos-4; i<fontPos; i++) {
    if ( i >= 0 && i < len) {
      //Serial.println((int)text.charAt(currentStringPosition));
      int p = (int)text.charAt(i);
      if (p >= 32 & p < 127) {
        p -= 32;
        copydatablock(font[p], d0, fontPos-i-1);
      }
      //switch (text.charAt(currentStringPosition)) {
      //  default:
      //    copydatablock(num1, d0, fontPos-i-1);
      //    break;
      //}
    }
  }

  // Convert it to 8*22 and flip over
  byte d1[8][22];
  //int pos = currentPos - fontPos*8;
  int pos = currentPos - (fontPos-1) * 8;
  for (int i = 0; i < 8; i++) {
    for (int j=0; j<22; j++)
      d1[i][j] = d0[i][32-pos-j];
  }
    
  // Compute frame
  byte fr[8][8] = {0x00};
  // Left
  for (int i = 0; i < 8; i++) {
    for (int j=0; j<8; j++)
      fr[i][7-j] += d1[i][j]*0x80;
  }
  // Right
  for (int i = 0; i < 8; i++) {
    for (int j=0; j<8; j++)
      fr[i][j] += d1[i][j+14]*0x01;
  }
  // Middle
  for (int i=0; i<8;i++) {
    byte temp=0;
    for (int j = 1; j < 7; j++)
      temp = temp*2+d1[i][j+7];
    fr[i][0] += temp*2;
  }

  // Convert frame to 1D data fr0[]
  byte fr0[65];
  fr0[0] = 0xF2;
  for (int i=0; i< 8; i++){
    for (int j=0; j<8; j++) {
      fr0[i*8+j+1] = fr[i][j];
    }
  }

  for (int i = 0; i < 65; i++)
    Serial.write(fr0[i]);
}
